## conf/layer.conf
```bitbake
# Layer-Suchpfad erweitern
BBPATH := "${BBPATH}:${LAYERDIR}"

# Alle .bb und .bbappend Dateien im Layer erkennen
BBFILES += "${LAYERDIR}/recipes-*/*/*.bb \
            ${LAYERDIR}/recipes-*/*/*.bbappend \
            ${LAYERDIR}/recipes-*/*/*/*.bb \
            ${LAYERDIR}/recipes-*/*/*/*.bbappend"

# Layer-Metadaten
BBFILE_COLLECTIONS += "reiq"
BBFILE_PATTERN_reiq = "^${LAYERDIR}/"
BBFILE_PRIORITY_reiq = "6"

# Kompatibilität mit Yocto-Versionen (anpassen falls nötig)
LAYERSERIES_COMPAT_reiq = "scarthgap nanbield"
```
